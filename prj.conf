## CMakeLists.txt
```
zephyr_interface_library_named(cozy)
set(WITH_ZEPHYR 1)
set(WITH_ZEPHYR_LIB 1)
target_include_directories(cozy INTERFACE include)

add_definitions( 
    -DNANOCBOR_BYTEORDER_HEADER=<sys/byteorder.h>
    -DNANOCBOR_BE64TOH_FUNC=sys_be64_to_cpu
    -DNANOCBOR_HTOBE64_FUNC=sys_cpu_to_be64
    -DNANOCBOR_HTOBE32_FUNC=sys_cpu_to_be32 
    )

zephyr_library()
zephyr_library_sources(
    src/sign.c
    src/encrypt.c
    src/mac.c
    src/common.c
    NanoCBOR/src/decoder.c
    NanoCBOR/src/encoder.c
    )
zephyr_library_link_libraries(cozy)
zephyr_include_directories(include NanoCBOR/include)

target_link_libraries(cozy INTERFACE 
    zephyr_interface
    mbedTLS
    )
```

## prj.conf
```kconfig
CONFIG_TINYCBOR=y
CONFIG_MCUMGR=y
CONFIG_MBEDTLS=y
CONFIG_MBEDTLS_BUILTIN=y
CONFIG_MBEDTLS_CFG_FILE="config-suite-b.h"
CONFIG_ZTEST=y
CONFIG_PRINTK=y
```

## src/main.c
```c
#include <ztest.h>

extern void cose_test_sign_write(void);
extern void cose_test_sign_read(void);
extern void cose_test_encrypt0_write(void);
extern void cose_test_encrypt0_read(void);
extern void cose_test_mac0_write(void);
extern void cose_test_mac0_read(void);

/* test case main entry */
void test_main(void)
{
    ztest_test_suite(cose_tests,
        ztest_unit_test(cose_test_sign_write),
        ztest_unit_test(cose_test_sign_read),
        ztest_unit_test(cose_test_encrypt0_write),
        ztest_unit_test(cose_test_encrypt0_read),
        ztest_unit_test(cose_test_mac0_write),
        ztest_unit_test(cose_test_mac0_read));
    ztest_run_test_suite(cose_tests);
}
```

## src/common.c
```c
/*
 * Copyright 2020 RISE Research Institutes of Sweden
 *
 * Licensed under the Apache License, Version 2.0 (the "License");
 * you may not use this file except in compliance with the License.
 * You may obtain a copy of the License at
 * 
 *   http://www.apache.org/licenses/LICENSE-2.0
 * 
 * Unless required by applicable law or agreed to in writing,
 * software distributed under the License is distributed on an
 * "AS IS" BASIS, WITHOUT WARRANTIES OR CONDITIONS OF ANY
 * KIND, either express or implied.  See the License for the
 * specific language governing permissions and limitations
 * under the License.
 */

#include <cozy/cose.h>
#include <cozy/common.h>

void cose_set_kid(cose_key_t * key, const uint8_t * kid, size_t len_kid)
{
    key->kid = kid;
    key->len_kid = len_kid;
}

void cose_set_aad(cose_key_t * key, const uint8_t * aad, size_t len_aad)
{
    key->aad = aad;
    key->len_aad = len_aad;
}

int cose_encode_prot(cose_key_t * key, nanocbor_encoder_t * nc)
{
    nanocbor_fmt_map(nc, 1);
    nanocbor_fmt_int(nc, cose_header_algorithm);
    nanocbor_fmt_int(nc, key->alg);
    return nanocbor_encoded_len(nc);
}

void xxd(const uint8_t * data, size_t len, int w) 
{
    size_t i, j;
    for (i = 0; i < len; i += w) {
        for (j = 0; j < w; j++) {
            if (i + j == len) break;
            else printk("%02x ", *(data+i+j));
        }
        printk("\n");
    }
    printk("\n");
}
```

## src/cose.c
```c
#include "cose.h"
#include "encode.h"

int cose_sign_init(cose_sign_context * ctx,
        const uint8_t * key, size_t len_key,
        const uint8_t * kid, size_t len_kid) 
{
    mbedtls_entropy_init(&ctx->entropy);
    mbedtls_ctr_drbg_init(&ctx->ctr_drbg);
    if (mbedtls_ctr_drbg_seed(
                &ctx->ctr_drbg, mbedtls_entropy_func, 
                &ctx->entropy, COSE_ENTROPY_SEED, 
                strlen(COSE_ENTROPY_SEED)))
        return COSE_ERROR_MBEDTLS;
    ctx->key.len_kid = len_kid;
    memcpy(ctx->key.kid, kid, len_kid);

    mbedtls_pk_init(&ctx->pk);
    if (mbedtls_pk_parse_key(&ctx->pk, key, len_key + 1, NULL, 0)) 
        return COSE_ERROR_MBEDTLS;
    if (mbedtls_pk_get_type(&ctx->pk) == MBEDTLS_PK_ECKEY) { 
        if (mbedtls_pk_get_bitlen(&ctx->pk) == 256) {
            ctx->key.alg = cose_alg_ecdsa_sha_256;
            ctx->md_alg = MBEDTLS_MD_SHA256;
        } else if (mbedtls_pk_get_bitlen(&ctx->pk) == 384) {
            ctx->key.alg = cose_alg_ecdsa_sha_384;
            ctx->md_alg = MBEDTLS_MD_SHA384;
        } else if (mbedtls_pk_get_bitlen(&ctx->pk) == 512) {
            ctx->key.alg = cose_alg_ecdsa_sha_512;
            ctx->md_alg = MBEDTLS_MD_SHA512;
        } else return COSE_ERROR_UNSUPPORTED;
    } else return COSE_ERROR_UNSUPPORTED;
    return COSE_ERROR_NONE;
}

int cose_verify_init(cose_verify_context * ctx,
        const uint8_t * key, size_t len_key,
        const uint8_t * kid, size_t len_kid) 
{
    ctx->key.len_kid = len_kid;
    memcpy(ctx->key.kid, kid, len_kid);
    
    mbedtls_pk_init(&ctx->pk);
    if (mbedtls_pk_parse_public_key(&ctx->pk, key, len_key + 1)) 
        return COSE_ERROR_MBEDTLS;
    if (mbedtls_pk_get_type(&ctx->pk) == MBEDTLS_PK_ECKEY) { 
        if (mbedtls_pk_get_bitlen(&ctx->pk) == 256) {
            ctx->key.alg = cose_alg_ecdsa_sha_256;
            ctx->md_alg = MBEDTLS_MD_SHA256;
        } else if (mbedtls_pk_get_bitlen(&ctx->pk) == 384) {
            ctx->key.alg = cose_alg_ecdsa_sha_384;
            ctx->md_alg = MBEDTLS_MD_SHA384;
        } else if (mbedtls_pk_get_bitlen(&ctx->pk) == 512) {
            ctx->key.alg = cose_alg_ecdsa_sha_512;
            ctx->md_alg = MBEDTLS_MD_SHA512;
        } else return COSE_ERROR_UNSUPPORTED;
    } else return COSE_ERROR_UNSUPPORTED;
    return COSE_ERROR_NONE;
}

int cose_crypt_init(cose_crypt_context * ctx,
        const uint8_t * key, cose_alg alg,
        const uint8_t * kid, size_t len_kid) 
{
    ctx->key.alg = alg;
    ctx->cipher = MBEDTLS_CIPHER_ID_AES;
    ctx->key.len_kid = len_kid;
    memcpy(ctx->key.kid, kid, len_kid);

    if (ctx->key.alg == cose_alg_aes_gcm_128)
        ctx->key.len_key = 16;
    else if (ctx->key.alg == cose_alg_aes_gcm_192) 
        ctx->key.len_key = 24;
    else if (ctx->key.alg == cose_alg_aes_gcm_256)
        ctx->key.len_key = 32;
    else return COSE_ERROR_UNSUPPORTED;

    if (ctx->key.alg == cose_alg_aes_gcm_128 ||
            ctx->key.alg == cose_alg_aes_gcm_192 ||
            ctx->key.alg == cose_alg_aes_gcm_256) {
        ctx->len_mac = 16;
        mbedtls_gcm_init(&ctx->gcm);
        mbedtls_gcm_setkey(&ctx->gcm, ctx->cipher, key, ctx->key.len_key * 8);
    } else return COSE_ERROR_UNSUPPORTED;

    return COSE_ERROR_NONE;
}

int cose_sign_free(cose_sign_context * ctx) 
{
    mbedtls_pk_free(&ctx->pk);
    mbedtls_entropy_free(&ctx->entropy);
    mbedtls_ctr_drbg_free(&ctx->ctr_drbg);
    return COSE_ERROR_NONE;
}

int cose_verify_free(cose_verify_context * ctx) 
{
    mbedtls_pk_free(&ctx->pk);
    return COSE_ERROR_NONE;
}

int cose_crypt_free(cose_crypt_context * ctx) 
{
    if (ctx->key.alg == cose_alg_aes_gcm_128 || 
            ctx->key.alg == cose_alg_aes_gcm_192 ||
            ctx->key.alg == cose_alg_aes_gcm_256) {
        mbedtls_gcm_free(&ctx->gcm);
    } return COSE_ERROR_UNSUPPORTED;
    return COSE_ERROR_NONE;
}

int cose_sign_write(cose_sign_context * ctx, 
        const uint8_t * pld, size_t len_pld, 
        const uint8_t * aad, size_t len_aad,
        uint8_t * obj, size_t * len_obj) 
{

    size_t len_temp = *len_obj;
    uint8_t hash[128];
    uint8_t sig[384];

    if (cose_encode_sign_tbs(&ctx->key, pld, len_pld, aad, len_aad, obj, &len_temp)) 
        return COSE_ERROR_ENCODE;

    if (mbedtls_md(mbedtls_md_info_from_type(ctx->md_alg), obj, len_temp, hash)) 
        return COSE_ERROR_HASH;

    if (mbedtls_pk_sign(&ctx->pk, ctx->md_alg, hash, 0, sig, &len_temp, 
                mbedtls_ctr_drbg_random, &ctx->ctr_drbg)) 
        return COSE_ERROR_SIGN;

    if (cose_encode_sign_obj(&ctx->key, pld, len_pld, aad, len_aad, 
                sig, len_temp, obj, len_obj))
        return COSE_ERROR_ENCODE;

    return COSE_ERROR_NONE;
}

int cose_sign_read(cose_verify_context * ctx, 
        const uint8_t * obj, size_t len_obj, 
        const uint8_t * aad, size_t len_aad,
        uint8_t * pld, size_t * len_pld) 
{

    size_t len_temp = *len_pld;
    size_t len_sig;
    uint8_t sig[384];
    uint8_t hash[128];

    if (cose_decode_sign_obj(&ctx->key, obj, len_obj, aad, len_aad, pld, &len_temp, sig, &len_sig))
        return COSE_ERROR_DECODE;

    if (mbedtls_md(mbedtls_md_info_from_type(ctx->md_alg), pld, len_temp, hash)) 
        return COSE_ERROR_HASH;

    if (mbedtls_pk_verify(&ctx->pk, ctx->md_alg, hash, 0, sig, len_sig))
        return COSE_ERROR_AUTHENTICATE;

    if (cose_decode_sign_pld(obj, len_obj, pld, len_pld)) 
        return COSE_ERROR_DECODE;

    return COSE_ERROR_NONE;
}

int cose_crypt_encipher(
        cose_crypt_context * ctx,
        const uint8_t * pld, const size_t len_pld,
        const uint8_t * tbe, const size_t len_tbe,
        const uint8_t * iv, const size_t len_iv,
        uint8_t * enc) 
{
    if (ctx->key.alg == cose_alg_aes_gcm_128 || 
            ctx->key.alg == cose_alg_aes_gcm_192 ||
            ctx->key.alg == cose_alg_aes_gcm_256) {

        if (mbedtls_gcm_crypt_and_tag(&ctx->gcm, MBEDTLS_GCM_ENCRYPT, len_pld, 
                    iv, len_iv, tbe, len_tbe, pld, enc, ctx->len_mac, enc + len_pld))
            return COSE_ERROR_ENCRYPT;

    } else return COSE_ERROR_UNSUPPORTED;
    return COSE_ERROR_NONE;
}

int cose_crypt_decipher(
        cose_crypt_context * ctx,
        const uint8_t * enc, const size_t len_enc,
        const uint8_t * tbe, const size_t len_tbe,
        const uint8_t * iv, const size_t len_iv,
        uint8_t * pld, size_t * len_pld) 
{
    if (ctx->key.alg == cose_alg_aes_gcm_128 || 
            ctx->key.alg == cose_alg_aes_gcm_192 ||
            ctx->key.alg == cose_alg_aes_gcm_256) {

        *len_pld = len_enc - ctx->len_mac;
        if (mbedtls_gcm_auth_decrypt(&ctx->gcm, *len_pld, iv, len_iv, tbe, len_tbe, 
                    enc + *len_pld, ctx->len_mac, enc, pld))
            return COSE_ERROR_DECRYPT;
            
    } else return COSE_ERROR_UNSUPPORTED;
    return COSE_ERROR_NONE;
}

int cose_encrypt0_write(cose_crypt_context *ctx,
        const uint8_t * pld, size_t len_pld, 
        const uint8_t * aad, size_t len_aad,
        const uint8_t * iv, size_t len_iv,
        uint8_t * obj, size_t * len_obj) 
{
    size_t len_enc = len_pld + ctx->len_mac;
    uint8_t enc[len_enc];

    size_t len_tbe = len_aad + 32;
    uint8_t tbe[len_tbe];

    if (cose_encode_encrypt0_tbe(&ctx->key, aad, len_aad, tbe, &len_tbe)) 
        return COSE_ERROR_ENCODE;

    if (cose_crypt_encipher(ctx, pld, len_pld, tbe, len_tbe, iv, len_iv, enc))
        return COSE_ERROR_ENCRYPT;

    if (cose_encode_encrypt0_obj(&ctx->key, enc, len_enc, iv, len_iv, obj, len_obj)) 
        return COSE_ERROR_ENCODE;

    return COSE_ERROR_NONE;
}

int cose_encrypt0_read(cose_crypt_context * ctx,
        const uint8_t * obj, size_t len_obj, 
        const uint8_t * aad, size_t len_aad,
        uint8_t * pld, size_t * len_pld) 
{
    size_t len_enc = len_obj;
    uint8_t enc[len_enc];

    size_t len_tbe = len_aad + 32;
    uint8_t tbe[len_tbe];

    size_t len_iv = 12;
    uint8_t iv[len_iv];

    if (cose_encode_encrypt0_tbe(&ctx->key, aad, len_aad, tbe, &len_tbe)) 
        return COSE_ERROR_ENCODE;

    if (cose_decode_encrypt0_obj(obj, len_obj, enc, &len_enc, iv, &len_iv))
        return COSE_ERROR_DECODE; 

    if (cose_crypt_decipher(ctx, enc, len_enc, tbe, len_tbe, iv, len_iv, pld, len_pld))
        return COSE_ERROR_DECRYPT;

    return COSE_ERROR_NONE;
}
```

## src/cose.h
```c
#ifndef COSE_H
#define COSE_H

#include <zephyr.h>
#include <tinycbor/cbor.h>

#ifndef CONFIG_MBEDTLS_CFG_FILE
#include "mbedtls/config.h"
#else
#include CONFIG_MBEDTLS_CFG_FILE
#endif

#include <mbedtls/md.h>
#include <mbedtls/pk.h>
#include <mbedtls/gcm.h>
#include <mbedtls/ctr_drbg.h>
#include <mbedtls/entropy.h>

#define COSE_CONTEXT_SIGN "Signature"
#define COSE_CONTEXT_SIGN1 "Signature1"
#define COSE_CONTEXT_COUNTERSIGN "CounterSignature"
#define COSE_CONTEXT_MAC "MAC"
#define COSE_CONTEXT_MAC0 "MAC0"
#define COSE_CONTEXT_ENCRYPT "Encrypt"
#define COSE_CONTEXT_ENCRYPT0 "Encrypt0"
#define COSE_CONTEXT_ENC_RECIPIENT "Enc_Recipient"
#define COSE_CONTEXT_MAC_RECIPIENT "Mac_Recipient"
#define COSE_CONTEXT_REC_RECIPIENT "Rec_Recipient"

#define COSE_ENTROPY_SEED "This should be unique for every device."

#define COSE_ERROR_NONE                 0x00
#define COSE_ERROR_MBEDTLS              0x01
#define COSE_ERROR_TINYCBOR             0x02
#define COSE_ERROR_UNSUPPORTED          0x03
#define COSE_ERROR_ENCODE               0x04
#define COSE_ERROR_DECODE               0x05
#define COSE_ERROR_AUTHENTICATE         0x06
#define COSE_ERROR_MISMATCH             0x07
#define COSE_ERROR_HASH                 0x08
#define COSE_ERROR_ENCRYPT              0x09
#define COSE_ERROR_DECRYPT              0x0a
#define COSE_ERROR_SIGN                 0x0b
#define COSE_ERROR_OVERFLOW             0x0c

typedef enum {
    cose_tag_sign = 98,
    cose_tag_sign1 = 18,
    cose_tag_encrypt = 96,
    cose_tag_encrypt0 = 16,
    cose_tag_mac = 97,
    cose_tag_mac0 = 17,
} cose_tag;

typedef enum {
    cose_alg_aes_gcm_128 = 1,
    cose_alg_aes_gcm_192 = 2,
    cose_alg_aes_gcm_256 = 3,
    cose_alg_hmac_256_64 = 4,
    cose_alg_hmac_256_256 = 5,
    cose_alg_hmac_384_384 = 6,
    cose_alg_hmac_512_512 = 7,
    cose_alg_cbc_mac_128_64 = 14,
    cose_alg_cbc_mac_256_64 = 15,
    cose_alg_cbc_mac_128_128 = 25,
    cose_alg_cbc_mac_256_128 = 26,
    cose_alg_aes_ccm_16_64_128 = 10,
    cose_alg_aes_ccm_16_64_256 = 11,
    cose_alg_aes_ccm_64_64_128 = 12,
    cose_alg_aes_ccm_64_64_256 = 13,
    cose_alg_aes_ccm_16_128_128 = 30,
    cose_alg_aes_ccm_16_128_256 = 31,
    cose_alg_aes_ccm_64_128_128 = 32,
    cose_alg_aes_ccm_64_128_256 = 33,
    cose_alg_ecdh_es_hkdf_256 = -25,
    cose_alg_ecdh_es_hkdf_512 = -26,
    cose_alg_ecdh_ss_hkdf_256 = -27,
    cose_alg_ecdh_ss_hkdf_512 = -28,
    cose_alg_ecdh_es_a128kw = -29,
    cose_alg_ecdh_es_a192kw = -30,
    cose_alg_ecdh_es_a256kw = -31,
    cose_alg_ecdh_ss_a128kw = -32,
    cose_alg_ecdh_ss_a192kw = -33,
    cose_alg_ecdh_ss_a256kw = -34,
    cose_alg_aes_kw_128 = -3,
    cose_alg_aes_kw_192 = -4,
    cose_alg_aes_kw_256 = -5,
    cose_alg_direct = -6,
    cose_alg_direct_hkdf_hmac_sha_256 = -10,
    cose_alg_direct_hkdf_hmac_sha_512 = -11,
    cose_alg_direct_hkdf_aes_128 = -12,
    cose_alg_direct_hkdf_aes_256 = -13,
    cose_alg_ecdsa_sha_256 = -7,
    cose_alg_ecdsa_sha_384 = -35,
    cose_alg_ecdsa_sha_512 = -36,
} cose_alg;

typedef enum {
    cose_header_algorithm = 1,
    cose_header_critical = 2,
    cose_header_content_type = 3,
    cose_header_kid = 4,
    cose_header_iv = 5,
    cose_header_partial_iv = 6,
    cose_header_countersign = 7,
    cose_header_operation_time = 8,
    cose_header_countersign0 = 9,
    cose_header_hkdf_salt = -20,
    cose_header_kdf_u_name = -21,
    cose_header_kdf_u_nonce = -22,
    cose_header_kdf_u_other = -23,
    cose_header_kdf_v_name = -24,
    cose_header_kdf_v_nonce = -25,
    cose_header_kdf_v_other = -26,
    cose_header_ecdh_ephemeral = -1,
    cose_header_ecdh_static = -2,
    cose_header_ecdh_epk = -1,
    cose_header_ecdh_spk = -2,
    cose_header_ecdh_spk_kid = -3,
} cose_header;

typedef enum {
    cose_key_label_kty = 1,
    cose_key_label_kid = 2,
    cose_key_label_alg = 3,
    cose_key_label_key_ops = 4,
    cose_key_label_base_iv = 5,
} cose_key_label;

typedef enum {
    cose_key_op_sign = 1,
    cose_key_op_verify = 2,
    cose_key_op_encrypt = 3,
    cose_key_op_decrypt = 4,
    cose_key_op_wrap_key = 5,
    cose_key_op_unwrap_key = 6,
    cose_key_op_derive_key = 7,
    cose_key_op_derive_bits = 8,
    cose_key_op_mac_create = 9,
    cose_key_op_mac_verify = 10,
} cose_key_op;

typedef enum {
    cose_kty_okp = 1,
    cose_kty_ec2 = 2,
    cose_kty_symmetric = 4,
} cose_kty;

typedef enum {
    cose_ec_param_crv = -1,
    cose_ec_param_x = -2,
    cose_ec_param_y = -3,
    cose_ec_param_d = -4,
} cose_ec_param;

typedef enum {
    cose_octet_param_crv = -1,
    cose_octet_param_x = -2,
    cose_octet_param_d = -4,
} cose_octet_param;

typedef enum {
    cose_symmetric_param_K = -1,
} cose_symmetric_param;

typedef enum {
    cose_curve_p256 = 1,
    cose_curve_p384 = 2,
    cose_curve_p251 = 3,
    cose_curve_x25519 = 4,
    cose_curve_x448 = 5,
    cose_curve_ed25519 = 6,
    cose_curve_ed448 = 7,
} cose_curve;

typedef struct {
    cose_kty kty;
    uint8_t kid[16];
    cose_alg alg;
    size_t len_kid;
    size_t len_key;
} cose_key;

typedef struct {
    cose_key key;
    mbedtls_pk_context pk;
    mbedtls_md_type_t md_alg;
    mbedtls_ctr_drbg_context ctr_drbg;
    mbedtls_entropy_context entropy;
} cose_sign_context;

typedef struct {
    cose_key key;
    mbedtls_pk_context pk;
    mbedtls_md_type_t md_alg;
} cose_verify_context;

typedef struct {
    cose_key key;
    int cipher;
    size_t len_mac;
    mbedtls_gcm_context gcm;
} cose_crypt_context;

int cose_sign_init(cose_sign_context * ctx,
        const uint8_t * key, size_t len_key,
        const uint8_t * kid, size_t len_kid);

int cose_verify_init(cose_verify_context * ctx,
        const uint8_t * key, size_t len_key,
        const uint8_t * kid, size_t len_kid);

int cose_crypt_init(cose_crypt_context * ctx,
        const uint8_t * key, cose_alg alg,
        const uint8_t * kid, size_t len_kid);

void cose_sign_free(cose_sign_context * ctx);
void cose_verify_free(cose_verify_context * ctx);
void cose_crypt_free(cose_crypt_context * ctx);

int cose_sign_write(cose_sign_context * ctx, 
        const uint8_t * pld, size_t len_pld, 
        const uint8_t * aad, size_t len_aad,
        uint8_t * obj, size_t * len_obj);

int cose_sign_read(cose_verify_context * ctx,
        const uint8_t * obj, size_t len_obj, 
        const uint8_t * aad, size_t len_aad,
        uint8_t * pld, size_t * len_pld);

int cose_encrypt0_write(cose_crypt_context *ctx,
        const uint8_t * pld, size_t len_pld, 
        const uint8_t * aad, size_t len_aad,
        const uint8_t * iv, size_t len_iv,
        uint8_t * obj, size_t * len_obj);

int cose_encrypt0_read(cose_crypt_context * ctx,
        const uint8_t * obj, size_t len_obj, 
        const uint8_t * aad, size_t len_aad,
        uint8_t * pld, size_t * len_pld);

int cose_mac0_write(cose_crypt_context *ctx,
        const uint8_t * pld, size_t len_pld, 
        const uint8_t * aad, size_t len_aad,
        const uint8_t * iv, size_t len_iv,
        uint8_t * obj, size_t * len_obj);

int cose_mac0_read(cose_crypt_context * ctx,
        const uint8_t * obj, size_t len_obj, 
        const uint8_t * aad, size_t len_aad,
        uint8_t * pld, size_t * len_pld);

#endif /* COSE_H */
```

## src/encode.c
```c
#include "cose.h"
#include "encode.h"

int cose_encode_protected(
        cose_key * key,
        uint8_t * pro, size_t * len_pro) 
{
    CborEncoder encoder_pro0, encoder_map0;

    cbor_encoder_init(&encoder_pro0, pro, *len_pro, 0);
    cbor_encoder_create_map(&encoder_pro0, &encoder_map0, 1);
    cbor_encode_int(&encoder_map0, cose_header_algorithm); 
    cbor_encode_int(&encoder_map0, key->alg);
    cbor_encoder_close_container(&encoder_pro0, &encoder_map0);

    if (cbor_encoder_get_extra_bytes_needed(&encoder_pro0)) 
        return COSE_ERROR_OVERFLOW;
    *len_pro = cbor_encoder_get_buffer_size(&encoder_pro0, pro);

    return COSE_ERROR_NONE;
}

int cose_encode_sign_tbs(
        cose_key * key,
        const uint8_t * pld, size_t len_pld, 
        const uint8_t * aad, size_t len_aad,
        uint8_t * tbs, size_t * len_tbs) 
{
    size_t len_pro = 8;
    uint8_t pro[len_pro];

    CborEncoder encoder_obj0, encoder_arr0;

    cbor_encoder_init(&encoder_obj0, tbs, *len_tbs, 0);
    cbor_encoder_create_array(&encoder_obj0, &encoder_arr0, 5);                 // Sig_Structure
    cbor_encode_text_string(&encoder_arr0, COSE_CONTEXT_SIGN,                   // context
            strlen(COSE_CONTEXT_SIGN));
    cbor_encode_byte_string(&encoder_arr0, NULL, 0);                            // body_protected
    cose_encode_protected(key, pro, &len_pro);                                  // sign_protected
    cbor_encode_byte_string(&encoder_arr0, pro, len_pro);
    cbor_encode_byte_string(&encoder_arr0, aad, len_aad);                       // external_aad
    cbor_encode_byte_string(&encoder_arr0, pld, len_pld);                       // payload
    cbor_encoder_close_container(&encoder_obj0, &encoder_arr0);

    if (cbor_encoder_get_extra_bytes_needed(&encoder_obj0)) 
        return COSE_ERROR_TINYCBOR;
    *len_tbs = cbor_encoder_get_buffer_size(&encoder_obj0, tbs);

     return COSE_ERROR_NONE;
}

int cose_encode_sign_obj(
        cose_key * key,
        const uint8_t * pld, size_t len_pld, 
        const uint8_t * aad, size_t len_aad,
        const uint8_t * sig, size_t len_sig,
        uint8_t * obj, size_t * len_obj) 
{
    size_t len_pro = 8;
    uint8_t pro[len_pro];

    CborEncoder encoder_obj0, encoder_arr0, 
                encoder_arr1, encoder_arr2,
                encoder_map0;

    cbor_encoder_init(&encoder_obj0, obj, *len_obj, 0);
    cbor_encode_tag(&encoder_obj0, cose_tag_sign);                              // tag
    cbor_encoder_create_array(&encoder_obj0, &encoder_arr0, 4);
    cbor_encode_byte_string(&encoder_arr0, NULL, 0);                            // protected
    cbor_encoder_create_map(&encoder_arr0, &encoder_map0, 0);                   // unprotected
    cbor_encoder_close_container(&encoder_arr0, &encoder_map0);
    cbor_encode_byte_string(&encoder_arr0, pld, len_pld);                       // payload
    cbor_encoder_create_array(&encoder_arr0, &encoder_arr1, 1);                 // signatures
    cbor_encoder_create_array(&encoder_arr1, &encoder_arr2, 3);
    cose_encode_protected(key, pro, &len_pro);                              // sign_protected
    cbor_encode_byte_string(&encoder_arr0, pro, len_pro);
    cbor_encoder_create_map(&encoder_arr2, &encoder_map0, 1);                   // unprotected
    cbor_encode_int(&encoder_map0, cose_header_kid);                            // kid
    cbor_encode_byte_string(&encoder_map0, key->kid, key->len_kid);
    cbor_encoder_close_container(&encoder_arr2, &encoder_map0);
    cbor_encode_byte_string(&encoder_arr1, sig, len_sig);                       // signature
    cbor_encoder_close_container(&encoder_arr1, &encoder_arr2);
    cbor_encoder_close_container(&encoder_arr0, &encoder_arr1);
    cbor_encoder_close_container(&encoder_obj0, &encoder_arr0);

    if (cbor_encoder_get_extra_bytes_needed(&encoder_obj0)) 
        return COSE_ERROR_TINYCBOR;
    *len_obj = cbor_encoder_get_buffer_size(&encoder_obj0, obj);

     return COSE_ERROR_NONE;
}

int cose_decode_sign_pld(
        const uint8_t * obj, size_t len_obj,
        uint8_t * pld, size_t * len_pld) 
{
    CborParser parser;
    CborValue par0, par1;
    if (cbor_parser_init(obj, len_obj, 0, &parser, &par0) != CborNoError)
        return COSE_ERROR_TINYCBOR;
    cbor_value_skip_tag(&par0);                                      
    cbor_value_enter_container(&par0, &par1);                                   // protected
    cbor_value_advance(&par1);                                                  // unprotected 
    cbor_value_advance(&par1);                                                  // payload

    if (cbor_value_copy_byte_string(&par1, pld, len_pld, &par1) != CborNoError) 
        return COSE_ERROR_TINYCBOR;

     return COSE_ERROR_NONE;
}

int cose_decode_sign_obj(
        cose_key * key,
        const uint8_t * obj, size_t len_obj,
        const uint8_t * aad, size_t len_aad,
        uint8_t * tbs, size_t * len_tbs,
        uint8_t * sig, size_t * len_sig) 
{
    CborParser parser;
    CborValue par0, par1, par2, par3;
    if (cbor_parser_init(obj, len_obj, 0, &parser, &par0) != CborNoError)
        return COSE_ERROR_TINYCBOR;
    cbor_value_skip_tag(&par0);                                      
    cbor_value_enter_container(&par0, &par1);                                   // protected
    cbor_value_advance(&par1);                                                  // unprotected 
    cbor_value_advance(&par1);                                                  // payload

    size_t len_pld;
    cbor_value_get_string_length(&par1, &len_pld);
    uint8_t pld[len_pld];

    if (cbor_value_copy_byte_string(&par1, pld, &len_pld, &par1) != CborNoError) 
        return COSE_ERROR_TINYCBOR;

    if (cose_encode_sign_tbs(key, pld, len_pld, aad, len_aad, tbs, len_tbs)) 
        return COSE_ERROR_ENCODE;

    cbor_value_enter_container(&par1, &par2);
    cbor_value_enter_container(&par2, &par3);                                   // protected
    cbor_value_advance(&par3);                                                  // unprotected
    cbor_value_advance(&par3);                                                  // signature

    cbor_value_get_string_length(&par3, len_sig);
    if (cbor_value_copy_byte_string(&par3, sig, len_sig, &par3) != CborNoError) 
        return COSE_ERROR_TINYCBOR;
    
     return COSE_ERROR_NONE;
}

int cose_encode_encrypt0_tbe(
        cose_key * key,
        const uint8_t * aad, size_t len_aad,
        uint8_t * tbe, size_t * len_tbe)
{
    size_t len_pro = 8;
    uint8_t pro[len_pro];

    CborEncoder encoder_obj0, encoder_arr0;

    cbor_encoder_init(&encoder_obj0, tbe, *len_tbe, 0);
    cbor_encoder_create_array(&encoder_obj0, &encoder_arr0, 3);                 // Enc_structure
    cbor_encode_text_string(&encoder_arr0, COSE_CONTEXT_ENCRYPT0,               // context
            strlen(COSE_CONTEXT_ENCRYPT0));
    cose_encode_protected(key, pro, &len_pro);                                  // protected
    cbor_encode_byte_string(&encoder_arr0, pro, len_pro);
    cbor_encode_byte_string(&encoder_arr0, aad, len_aad);                       // external_aad
    cbor_encoder_close_container(&encoder_obj0, &encoder_arr0);

    if (cbor_encoder_get_extra_bytes_needed(&encoder_obj0)) 
        return COSE_ERROR_TINYCBOR;
    *len_tbe = cbor_encoder_get_buffer_size(&encoder_obj0, tbe);

     return COSE_ERROR_NONE;
}

int cose_encode_encrypt0_obj(
        cose_key * key,
        const uint8_t * enc, size_t len_enc, 
        const uint8_t * iv, size_t len_iv,
        uint8_t * obj, size_t * len_obj) 
{
    size_t len_pro = 8;
    uint8_t pro[len_pro];

    CborEncoder encoder_obj0, encoder_arr0, 
                encoder_map0;

    cbor_encoder_init(&encoder_obj0, obj, *len_obj, 0);
    cbor_encode_tag(&encoder_obj0, cose_tag_encrypt0);                          // tag
    cbor_encoder_create_array(&encoder_obj0, &encoder_arr0, 3);
    cose_encode_protected(key, pro, &len_pro);                                  // protected
    cbor_encode_byte_string(&encoder_arr0, pro, len_pro);
    cbor_encoder_create_map(&encoder_arr0, &encoder_map0, 1);                   // unprotected
    cbor_encode_int(&encoder_map0, cose_header_iv);
    cbor_encode_byte_string(&encoder_map0, iv, len_iv);                         // iv 
    cbor_encoder_close_container(&encoder_arr0, &encoder_map0);
    cbor_encode_byte_string(&encoder_arr0, enc, len_enc);                       // ciphertext
    cbor_encoder_close_container(&encoder_obj0, &encoder_arr0);

    if (cbor_encoder_get_extra_bytes_needed(&encoder_obj0)) 
        return COSE_ERROR_TINYCBOR;
    *len_obj = cbor_encoder_get_buffer_size(&encoder_obj0, obj);

     return COSE_ERROR_NONE;
} 

int cose_decode_encrypt0_obj(
        const uint8_t * obj, size_t len_obj,
        uint8_t * enc, size_t * len_enc,
        uint8_t * iv, size_t * len_iv)
{
    CborParser parser;
    CborValue par0, par1, par2;
    if (cbor_parser_init(obj, len_obj, 0, &parser, &par0) != CborNoError)
        return COSE_ERROR_TINYCBOR;
    cbor_value_skip_tag(&par0);                                      
    cbor_value_enter_container(&par0, &par1);                                   // protected
    cbor_value_advance(&par1);                                                  // unprotected 
    cbor_value_enter_container(&par1, &par2);                                   // iv
    
    int header;
    if (cbor_value_get_int(&par2, &header)) return COSE_ERROR_DECODE;
    if (header != cose_header_iv) return COSE_ERROR_DECODE;
    cbor_value_advance(&par2);
    if (cbor_value_copy_byte_string(&par2, iv, len_iv, &par2) != CborNoError)
        return COSE_ERROR_TINYCBOR;
    cbor_value_leave_container(&par1, &par2);

    if (cbor_value_copy_byte_string(&par1, enc, len_enc, &par1) != CborNoError)
        return COSE_ERROR_TINYCBOR;
    
     return COSE_ERROR_NONE;
}
```

## src/encode.h
```c
#ifndef ENCODE_H
#define ENCODE_H

#include "cose.h"

int cose_encode_protected(
        cose_key * key,
        uint8_t * pro, size_t * len_pro);

int cose_encode_sign_tbs(
        cose_key * key,
        const uint8_t * pld, size_t len_pld, 
        const uint8_t * aad, size_t len_aad,
        uint8_t * tbs, size_t * len_tbs);

int cose_encode_sign_obj(
        cose_key * key,
        const uint8_t * pld, size_t len_pld, 
        const uint8_t * aad, size_t len_aad,
        const uint8_t * sig, size_t len_sig,
        uint8_t * obj, size_t * len_obj);
    
int cose_decode_sign_pld(
        const uint8_t * obj, size_t len_obj,
        uint8_t * pld, size_t * len_pld);

int cose_decode_sign_obj(
        cose_key * key,
        const uint8_t * obj, size_t len_obj,
        const uint8_t * aad, size_t len_aad,
        uint8_t * tbs, size_t * len_tbs,
        uint8_t * sig, size_t * len_sig); 

int cose_encode_encrypt0_tbe(
        cose_key * key,
        const uint8_t * aad, size_t len_aad,
        uint8_t * tbe, size_t * len_tbe);

int cose_encode_encrypt0_obj(
        cose_key * key,
        const uint8_t * enc, size_t len_enc, 
        const uint8_t * iv, size_t len_iv,
        uint8_t * obj, size_t * len_obj);

int cose_decode_encrypt0_obj(
        const uint8_t * obj, size_t len_obj,
        uint8_t * enc, size_t * len_enc,
        uint8_t * iv, size_t * len_iv);

#endif /* ENCODE_H */
```

## src/encrypt.c
```c
/*
 * Copyright 2020 RISE Research Institutes of Sweden
 *
 * Licensed under the Apache License, Version 2.0 (the "License");
 * you may not use this file except in compliance with the License.
 * You may obtain a copy of the License at
 * 
 *   http://www.apache.org/licenses/LICENSE-2.0
 * 
 * Unless required by applicable law or agreed to in writing,
 * software distributed under the License is distributed on an
 * "AS IS" BASIS, WITHOUT WARRANTIES OR CONDITIONS OF ANY
 * KIND, either express or implied.  See the License for the
 * specific language governing permissions and limitations
 * under the License.
 */

#ifdef CONFIG_COZY_ENCRYPT

#include <cozy/cose.h>
#include <cozy/common.h>

int cose_crypt_init(cose_crypt_context_t * ctx,
        const uint8_t * key, cose_alg_t alg,
        uint8_t * iv, const size_t len_iv) 
{
    ctx->key.alg = alg;
    ctx->cipher = MBEDTLS_CIPHER_ID_AES;
    ctx->iv = iv;
    ctx->len_iv = len_iv;
    ctx->key.kid = NULL;
    ctx->key.len_kid = 0;
    ctx->key.aad = NULL;
    ctx->key.len_aad = 0;

    if (ctx->key.alg == cose_alg_aes_gcm_128)
        ctx->key.len_key = 16;
    else if (ctx->key.alg == cose_alg_aes_gcm_192) 
        ctx->key.len_key = 24;
    else if (ctx->key.alg == cose_alg_aes_gcm_256)
        ctx->key.len_key = 32;
    else return COSE_ERROR_UNSUPPORTED;

    if (ctx->key.alg == cose_alg_aes_gcm_128 ||
            ctx->key.alg == cose_alg_aes_gcm_192 ||
            ctx->key.alg == cose_alg_aes_gcm_256) {
        ctx->len_mac = 16;
        mbedtls_gcm_init(&ctx->gcm);
        mbedtls_gcm_setkey(&ctx->gcm, ctx->cipher, 
                key, ctx->key.len_key * 8);
    } else return COSE_ERROR_UNSUPPORTED;

    return COSE_ERROR_NONE;
}

int cose_do_encrypt(
        cose_crypt_context_t * ctx,
        const uint8_t * pld, const size_t len_pld,
        const uint8_t * tbe, const size_t len_tbe,
        uint8_t * enc) 
{
    if (ctx->key.alg == cose_alg_aes_gcm_128 || 
        ctx->key.alg == cose_alg_aes_gcm_192 ||
        ctx->key.alg == cose_alg_aes_gcm_256) {

        if (mbedtls_gcm_crypt_and_tag(
                    &ctx->gcm, MBEDTLS_GCM_ENCRYPT, 
                    len_pld, ctx->iv, ctx->len_iv, tbe, len_tbe, 
                    pld, enc, ctx->len_mac, enc + len_pld))
            return COSE_ERROR_ENCRYPT;

    } else return COSE_ERROR_UNSUPPORTED;
    return COSE_ERROR_NONE;
}

int cose_do_decrypt(
        cose_crypt_context_t * ctx,
        const uint8_t * enc, const size_t len_enc,
        const uint8_t * tbe, const size_t len_tbe,
        uint8_t * pld, size_t * len_pld) 
{
    if (ctx->key.alg == cose_alg_aes_gcm_128 || 
        ctx->key.alg == cose_alg_aes_gcm_192 ||
        ctx->key.alg == cose_alg_aes_gcm_256) {

        *len_pld = len_enc - ctx->len_mac;
        if (mbedtls_gcm_auth_decrypt(
                    &ctx->gcm, *len_pld, 
                    ctx->iv, ctx->len_iv, 
                    tbe, len_tbe, enc + *len_pld, 
                    ctx->len_mac, enc, pld))
            return COSE_ERROR_DECRYPT;
            
    } else return COSE_ERROR_UNSUPPORTED;
    return COSE_ERROR_NONE;
}

int cose_tbe0(
        cose_key_t * key,
        uint8_t * tbe, size_t * len_tbe)
{
    /* serialize protected */
    nanocbor_encoder_t nc;
    nanocbor_encoder_init(&nc, NULL, 0);
    size_t len_prot = cose_encode_prot(key, &nc);
    uint8_t prot[len_prot];
    nanocbor_encoder_init(&nc, prot, len_prot);
    cose_encode_prot(key, &nc);
   
    /* get size of Enc_structure */
    nanocbor_encoder_init(&nc, NULL, 0);
    nanocbor_fmt_array(&nc, 3);
    nanocbor_put_tstr(&nc, COSE_CONTEXT_ENCRYPT0);
    nanocbor_put_bstr(&nc, prot, len_prot);
    nanocbor_put_bstr(&nc, key->aad, key->len_aad);
    size_t len_struct = nanocbor_encoded_len(&nc);

    /* serialize to byte stream */
    nanocbor_encoder_init(&nc, tbe, *len_tbe);
    nanocbor_fmt_bstr(&nc, len_struct);
    nanocbor_fmt_array(&nc, 3);
    nanocbor_put_tstr(&nc, COSE_CONTEXT_ENCRYPT0);
    nanocbor_put_bstr(&nc, prot, len_prot);
    nanocbor_put_bstr(&nc, key->aad, key->len_aad);
    *len_tbe = nanocbor_encoded_len(&nc);

    return COSE_ERROR_NONE;
}

int cose_encrypt0_encode(
        cose_crypt_context_t * ctx,
        const uint8_t * enc, const size_t len_enc, 
        uint8_t * obj, size_t * len_obj) 
{
    nanocbor_encoder_t nc;
    nanocbor_encoder_init(&nc, NULL, 0);
    size_t len_prot = cose_encode_prot(&ctx->key, &nc);
    uint8_t prot[len_prot];
    nanocbor_encoder_init(&nc, prot, len_prot);
    cose_encode_prot(&ctx->key, &nc);

    nanocbor_encoder_init(&nc, obj, *len_obj);
    nanocbor_fmt_tag(&nc, cose_tag_encrypt0);
    nanocbor_fmt_array(&nc, 3);
    nanocbor_put_bstr(&nc, prot, len_prot);
    nanocbor_fmt_map(&nc, 2);
    nanocbor_fmt_int(&nc, cose_header_kid);
    nanocbor_put_bstr(&nc, ctx->key.kid, ctx->key.len_kid);
    nanocbor_fmt_int(&nc, cose_header_iv);
    nanocbor_put_bstr(&nc, ctx->iv, ctx->len_iv);
    nanocbor_put_bstr(&nc, enc, len_enc);

    *len_obj = nanocbor_encoded_len(&nc);
    return COSE_ERROR_NONE;
} 

int cose_encrypt0_decode(
        cose_crypt_context_t * ctx,
        const uint8_t * obj, const size_t len_obj,
        const uint8_t ** enc, size_t * len_enc)
{
    nanocbor_value_t nc, arr, map;
    nanocbor_decoder_init(&nc, obj, len_obj);
    nanocbor_skip(&nc);
    if (nanocbor_enter_array(&nc, &arr) < 0) 
        return COSE_ERROR_DECODE;
    nanocbor_skip(&arr); 
    if (nanocbor_enter_map(&arr, &map) < 0) 
        return COSE_ERROR_DECODE;

    while (!nanocbor_at_end(&map)) {
        int32_t map_key;
        if (nanocbor_get_int32(&map, &map_key) < 0) 
            return COSE_ERROR_DECODE;
        if (map_key == cose_header_iv) {
            if (nanocbor_get_bstr(
                        &map, (const uint8_t **) &ctx->iv, 
                        &ctx->len_iv) < 0)
                return COSE_ERROR_DECODE;
            else break;
        }
        nanocbor_skip(&map); 
    }

    nanocbor_skip(&arr); 
    if (nanocbor_get_bstr(&arr, enc, len_enc) < 0)
        return COSE_ERROR_DECODE;

    return COSE_ERROR_NONE;
}

int cose_encrypt0_write(cose_crypt_context_t *ctx,
        const uint8_t * pld, const size_t len_pld, 
        uint8_t * obj, size_t * len_obj) 
{
    size_t len_enc = len_pld + ctx->len_mac;
    uint8_t enc[len_enc];

    size_t len_tbe = len_pld + ctx->key.len_aad;
    uint8_t tbe[len_tbe];

    if (cose_tbe0(
                &ctx->key,
                tbe, &len_tbe)) 
        return COSE_ERROR_ENCODE;

    if (cose_do_encrypt(
                ctx, 
                pld, len_pld, 
                tbe, len_tbe, 
                enc))
        return COSE_ERROR_ENCRYPT;

    if (cose_encrypt0_encode(
                ctx,
                enc, len_enc, 
                obj, len_obj)) 
        return COSE_ERROR_ENCODE;

    return COSE_ERROR_NONE;
}

int cose_encrypt0_read(cose_crypt_context_t * ctx,
        const uint8_t * obj, const size_t len_obj, 
        uint8_t * pld, size_t * len_pld) 
{
    size_t len_tbe = len_obj + ctx->key.len_aad;
    uint8_t tbe[len_tbe];

    uint8_t * enc; size_t len_enc;

    if (cose_tbe0(
                &ctx->key, 
                tbe, &len_tbe)) 
        return COSE_ERROR_ENCODE;

    if (cose_encrypt0_decode(
                ctx, obj, len_obj, 
                (const uint8_t **) &enc, &len_enc))
        return COSE_ERROR_DECODE;

    if (cose_do_decrypt(ctx,
                enc, len_enc, 
                tbe, len_tbe, 
                pld, len_pld))
        return COSE_ERROR_DECRYPT;

    return COSE_ERROR_NONE;
}

void cose_crypt_free(cose_crypt_context_t * ctx) 
{
     mbedtls_gcm_free(&ctx->gcm);
}
#endif /* CONFIG_COZY_ENCRYPT */
```

## src/mac.c
```c
/*
 * Copyright 2020 RISE Research Institutes of Sweden
 *
 * Licensed under the Apache License, Version 2.0 (the "License");
 * you may not use this file except in compliance with the License.
 * You may obtain a copy of the License at
 * 
 *   http://www.apache.org/licenses/LICENSE-2.0
 * 
 * Unless required by applicable law or agreed to in writing,
 * software distributed under the License is distributed on an
 * "AS IS" BASIS, WITHOUT WARRANTIES OR CONDITIONS OF ANY
 * KIND, either express or implied.  See the License for the
 * specific language governing permissions and limitations
 * under the License.
 */

#ifdef CONFIG_COZY_MAC

#include <cozy/cose.h>
#include <cozy/common.h>

int cose_mac0_write(cose_crypt_context_t *ctx,
        const uint8_t * pld, const size_t len_pld, 
        uint8_t * obj, size_t * len_obj) 
{

    return COSE_ERROR_NONE;
}

int cose_mac0_read(cose_crypt_context_t * ctx,
        const uint8_t * obj, const size_t len_obj, 
        uint8_t * pld, size_t * len_pld)
{

    return COSE_ERROR_NONE;
}

#endif /* CONFIG_COZY_MAC */
```

## src/shared.c
```c
/*
 * Copyright 2020 RISE Research Institutes of Sweden
 *
 * Licensed under the Apache License, Version 2.0 (the "License");
 * you may not use this file except in compliance with the License.
 * You may obtain a copy of the License at
 * 
 *   http://www.apache.org/licenses/LICENSE-2.0
 * 
 * Unless required by applicable law or agreed to in writing,
 * software distributed under the License is distributed on an
 * "AS IS" BASIS, WITHOUT WARRANTIES OR CONDITIONS OF ANY
 * KIND, either express or implied.  See the License for the
 * specific language governing permissions and limitations
 * under the License.
 */

#include <cozy/cose.h>
#include <cozy/common.h>

int cose_encode_final(
        CborEncoder * encoder, 
        uint8_t * out, size_t * len_out)
{
    if (cbor_encoder_get_extra_bytes_needed(encoder))
        return COSE_ERROR_OVERFLOW;
    *len_out = cbor_encoder_get_buffer_size(encoder, out);
    return COSE_ERROR_NONE;
}

int cose_decode_final(
        CborValue * decoder, 
        uint8_t * out, size_t * len_out)
{
    int len_tmp = 0;
    cbor_value_get_string_length(decoder, &len_tmp);
    if (*len_out < len_tmp) return COSE_ERROR_OVERFLOW;
    *len_out = len_tmp;
    if (cbor_value_copy_byte_string(decoder, out, len_out, decoder) != CborNoError)
        return COSE_ERROR_DECODE;
     return COSE_ERROR_NONE;
}

int cose_encode_protected(
        cose_key * key,
        uint8_t * pro, size_t * len_pro) 
{
    CborEncoder encoder_pro0, encoder_map0;

    cbor_encoder_init(&encoder_pro0, pro, *len_pro, 0);
    cbor_encoder_create_map(&encoder_pro0, &encoder_map0, 1);
    CBOR_MAP_INT(&encoder_map0, cose_header_algorithm, key->alg);
    cbor_encoder_close_container(&encoder_pro0, &encoder_map0);

    if (cbor_encoder_get_extra_bytes_needed(&encoder_pro0)) 
        return COSE_ERROR_OVERFLOW;
    *len_pro = cbor_encoder_get_buffer_size(&encoder_pro0, pro);

    return COSE_ERROR_NONE;
}
```

## src/shared.h
```c
#ifndef SHARED_H
#define SHARED_H

#include "cose.h"

int cose_encode_protected(
        cose_key * key,
        uint8_t * pro, size_t * len_pro);

int cose_encode_sign_tbs(
        cose_key * key,
        const uint8_t * pld, size_t len_pld, 
        const uint8_t * aad, size_t len_aad,
        uint8_t * tbs, size_t * len_tbs);

int cose_encode_sign_object(
        cose_key * key,
        const uint8_t * pld, size_t len_pld, 
        const uint8_t * aad, size_t len_aad,
        const uint8_t * sig, size_t len_sig,
        uint8_t * obj, size_t * len_obj);
    
int cose_decode_sign_payload(
        const uint8_t * obj, size_t len_obj,
        uint8_t * pld, size_t * len_pld);

int cose_decode_sign_object(
        cose_key * key,
        const uint8_t * obj, size_t len_obj,
        const uint8_t * aad, size_t len_aad,
        uint8_t * tbs, size_t * len_tbs,
        uint8_t * sig, size_t * len_sig); 

int cose_encode_encrypt0_tbe(
        cose_key * key,
        const uint8_t * aad, size_t len_aad,
        uint8_t * tbe, size_t * len_tbe);

int cose_encode_encrypt0_object(
        cose_key * key,
        const uint8_t * enc, size_t len_enc, 
        const uint8_t * iv, size_t len_iv,
        uint8_t * obj, size_t * len_obj);

int cose_decode_encrypt0_object(
        const uint8_t * obj, size_t len_obj,
        uint8_t * enc, size_t * len_enc,
        uint8_t * iv, size_t * len_iv);

#endif /* SHARED_H */
```

## src/sign.c
```c
/*
 * Copyright 2020 RISE Research Institutes of Sweden
 *
 * Licensed under the Apache License, Version 2.0 (the "License");
 * you may not use this file except in compliance with the License.
 * You may obtain a copy of the License at
 * 
 *   http://www.apache.org/licenses/LICENSE-2.0
 * 
 * Unless required by applicable law or agreed to in writing,
 * software distributed under the License is distributed on an
 * "AS IS" BASIS, WITHOUT WARRANTIES OR CONDITIONS OF ANY
 * KIND, either express or implied.  See the License for the
 * specific language governing permissions and limitations
 * under the License.
 */

#ifdef CONFIG_COZY_SIGN

#include <cozy/cose.h>
#include <cozy/common.h>

#define HASH_TSTR(md_ctx, nc, buf, len_buf, str)                \
    nanocbor_encoder_init(&nc, buf, len_buf);                   \
    nanocbor_fmt_tstr(&nc, strlen(str));                        \
    mbedtls_md_update(&md_ctx, buf, nanocbor_encoded_len(&nc)); \
    mbedtls_md_update(&md_ctx, str, strlen(str));

#define HASH_BSTR(md_ctx, nc, buf, len_buf, bstr, len_bstr)     \
    nanocbor_encoder_init(&nc, buf, len_buf);                   \
    nanocbor_fmt_bstr(&nc, len_bstr);                           \
    mbedtls_md_update(&md_ctx, buf, nanocbor_encoded_len(&nc)); \
    mbedtls_md_update(&md_ctx, bstr, len_bstr);

int cose_sign_init(
        cose_sign_context_t * ctx, 
        cose_mode_t mode,
        const uint8_t * pem) 
{
    mbedtls_pk_init(&ctx->pk);

    if (mode == cose_mode_r) {
        ctx->key.op = cose_key_op_verify;
        if (mbedtls_pk_parse_public_key(
                    &ctx->pk, pem, strlen(pem) + 1)) 
            return COSE_ERROR_MBEDTLS;
    } else if (mode == cose_mode_w) {
        ctx->key.op = cose_key_op_sign;
        if (mbedtls_pk_parse_key(
                    &ctx->pk, pem, strlen(pem) + 1, NULL, 0)) 
            return COSE_ERROR_MBEDTLS;
    } else return COSE_ERROR_UNSUPPORTED;

    ctx->key.kty = cose_kty_ec2;
    mbedtls_ecp_group_id grp_id = mbedtls_pk_ec(ctx->pk)->grp.id;

    if (grp_id == MBEDTLS_ECP_DP_SECP256R1) {
        ctx->len_hash = 32;
        ctx->key.crv = cose_curve_p256;
        ctx->key.alg = cose_alg_ecdsa_sha_256;
        ctx->md_alg = MBEDTLS_MD_SHA256;
        ctx->len_sig = 72;
    } else if (grp_id == MBEDTLS_ECP_DP_SECP384R1) {
        ctx->len_hash = 48;
        ctx->key.crv = cose_curve_p384;
        ctx->key.alg = cose_alg_ecdsa_sha_384;
        ctx->md_alg = MBEDTLS_MD_SHA384;
        ctx->len_sig = 104;
    } else return COSE_ERROR_UNSUPPORTED;

    ctx->key.kid = NULL;
    ctx->key.len_kid = 0;
    ctx->key.aad = NULL;
    ctx->key.len_aad = 0;

    return COSE_ERROR_NONE;
}

int cose_sign1_hash(cose_sign_context_t * ctx,
        const uint8_t *pld, const size_t len_pld,
        uint8_t * hash)
{
    mbedtls_md_context_t md_ctx;
    mbedtls_md_setup(&md_ctx, mbedtls_md_info_from_type(ctx->md_alg), 0);
    mbedtls_md_starts(&md_ctx);
    nanocbor_encoder_t nc;

    /* serialize body_protected */
    nanocbor_encoder_init(&nc, NULL, 0);
    size_t len_prot = cose_encode_prot(&ctx->key, &nc);
    uint8_t prot[len_prot];
    nanocbor_encoder_init(&nc, prot, len_prot);
    cose_encode_prot(&ctx->key, &nc);

    /* compute length of Sig_structure */
    nanocbor_encoder_init(&nc, NULL, 0);
    nanocbor_fmt_array(&nc, 4);
    nanocbor_put_tstr(&nc, COSE_CONTEXT_SIGN1);
    nanocbor_put_bstr(&nc, prot, len_prot);
    nanocbor_put_bstr(&nc, ctx->key.aad, ctx->key.len_aad);
    nanocbor_put_bstr(&nc, pld, len_pld);
    size_t len_str = nanocbor_encoded_len(&nc);

    /* serialize and hash ToBeSigned */
    size_t len_buf = 8;
    uint8_t buf[len_buf];

    nanocbor_encoder_init(&nc, buf, len_buf);
    nanocbor_fmt_bstr(&nc, len_str);
    nanocbor_fmt_array(&nc, 4);
    mbedtls_md_update(&md_ctx, buf, nanocbor_encoded_len(&nc));

    HASH_TSTR(md_ctx, nc, buf, len_buf, COSE_CONTEXT_SIGN1)
    HASH_BSTR(md_ctx, nc, buf, len_buf, prot, len_prot)
    HASH_BSTR(md_ctx, nc, buf, len_buf, ctx->key.aad, ctx->key.len_aad)
    HASH_BSTR(md_ctx, nc, buf, len_buf, pld, len_pld)

    if (mbedtls_md_finish(&md_ctx, hash)) return COSE_ERROR_HASH;
    return COSE_ERROR_NONE;
}

int cose_sign1_encode(
        cose_key_t * key,
        const uint8_t * pld, const size_t len_pld, 
        const uint8_t * sig, const size_t len_sig,
        uint8_t * obj, size_t * len_obj) 
{
    nanocbor_encoder_t nc;
    nanocbor_encoder_init(&nc, NULL, 0);
    size_t len_prot = cose_encode_prot(key, &nc);
    uint8_t prot[len_prot];
    nanocbor_encoder_init(&nc, prot, len_prot);
    cose_encode_prot(key, &nc);

    nanocbor_encoder_init(&nc, obj, *len_obj);
    nanocbor_fmt_tag(&nc, cose_tag_sign1);
    nanocbor_fmt_array(&nc, 4);
    nanocbor_put_bstr(&nc, prot, len_prot);
    nanocbor_fmt_map(&nc, 0);
    nanocbor_put_bstr(&nc, pld, len_pld);
    nanocbor_put_bstr(&nc, sig, len_sig);
    *len_obj = nanocbor_encoded_len(&nc);

    return COSE_ERROR_NONE;
}

int cose_sign1_decode(
        cose_sign_context_t * ctx,
        const uint8_t * obj, const size_t len_obj,
        const uint8_t ** pld, size_t * len_pld,
        const uint8_t ** sig, size_t * len_sig, 
        uint8_t * hash)
{
    nanocbor_value_t nc, arr;
    nanocbor_decoder_init(&nc, obj, len_obj);
    nanocbor_skip(&nc);
    if (nanocbor_enter_array(&nc, &arr) < 0) 
        return COSE_ERROR_DECODE;
    nanocbor_skip(&arr);
    nanocbor_skip(&arr);
    nanocbor_get_bstr(&arr, pld, len_pld); 

    cose_sign1_hash(ctx, *pld, *len_pld, hash);
    nanocbor_get_bstr(&arr, sig, len_sig); 

    return COSE_ERROR_NONE;
}

int cose_sign1_write(cose_sign_context_t * ctx, 
        const uint8_t * pld, const size_t len_pld, 
        uint8_t * obj, size_t * len_obj) 
{
    uint8_t hash[ctx->len_hash];
    uint8_t sig[ctx->len_sig];
    
    cose_sign1_hash(ctx, pld, len_pld, hash);

    if (mbedtls_ecdsa_write_signature(
                ctx->pk.pk_ctx, ctx->md_alg, 
                hash, ctx->len_hash, 
                sig, &ctx->len_sig, 
                NULL, NULL)) 
        return COSE_ERROR_SIGN;

    if (cose_sign1_encode(
                &ctx->key, 
                pld, len_pld, 
                sig, ctx->len_sig,
                obj, len_obj))
        return COSE_ERROR_ENCODE;

    return COSE_ERROR_NONE;
}

int cose_sign1_read(cose_sign_context_t * ctx, 
        const uint8_t * obj, const size_t len_obj, 
        const uint8_t ** pld, size_t * len_pld) 
{
    uint8_t hash[ctx->len_hash];
    uint8_t * sig;
    size_t len_sig;

    if (cose_sign1_decode(ctx, 
                obj, len_obj,
                pld, len_pld,
                (const uint8_t **) &sig, 
                &len_sig, hash))
        return COSE_ERROR_DECODE;

    if (mbedtls_pk_verify(
                &ctx->pk, ctx->md_alg, 
                hash, 0, sig, len_sig))
        return COSE_ERROR_AUTHENTICATE;

    return COSE_ERROR_NONE;
}

void cose_sign_free(cose_sign_context_t * ctx) 
{
    mbedtls_pk_free(&ctx->pk);
}

#endif /* CONFIG_COZY_SIGN */
```
