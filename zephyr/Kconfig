## zephyr/Kconfig
```kconfig
menuconfig COZY
    bool "Cozy Support"
    select MBEDTLS
    select MBEDTLS_ENABLE_HEAP
    help
        This option enables the Cozy COSE library.

if COZY

config COZY_SIGN
    bool "Compile COSE sign sources"
    select MBEDTLS_ECP_NIST_OPTIM
    select MBEDTLS_ECP_DP_SECP256R1_ENABLED
    select MBEDTLS_ECP_DP_SECP384R1_ENABLED
    select MBEDTLS_MAC_SHA512_ENABLED
    select MBEDTLS_KEY_EXCHANGE_ECDHE_ECDSA_ENABLED
    select MBEDTLS_HMAC_DRBG_ENABLED
    select MBEDTLS_PEM_CERTIFICATE_FORMAT
    select MBEDTLS_ECDSA_DETERMINISTIC
    default y

config COZY_ENCRYPT
    bool "Compile COSE encrypt sources"
    select MBEDTLS_CIPHER_MODE_GCM_ENABLED
    default y

config COZY_MAC
    bool "Compile COSE MAC sources"
    select MBEDTLS_CIPHER_MODE_GCM_ENABLED
    default y     

endif
```
